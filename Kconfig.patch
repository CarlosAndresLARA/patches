## Kconfig.patch
```kconfig
--- Kconfig	2021-10-27 12:07:50.890050000 +0200
+++ Kconfig_patched	2021-10-26 16:15:04.429018000 +0200
@@ -359,6 +359,12 @@
 	help
 	  Support for Memory Mapped IO Fixed clocks
 
+config GEM5_CPUFREQ_CLK
+	bool "Clk driver for GEM5 Platform"
+	help
+	  Enable clk hardware for cpufreq in gem5 platforms
+
+
 source "drivers/clk/actions/Kconfig"
 source "drivers/clk/analogbits/Kconfig"
 source "drivers/clk/baikal-t1/Kconfig"
```

## Kconfig.x86.patch
```kconfig
--- Kconfig.x86	2021-10-27 12:15:29.936930000 +0200
+++ Kconfig.x86_patched	2021-10-27 10:43:32.229875000 +0200
@@ -72,7 +72,7 @@
 config ELAN_CPUFREQ
 	tristate "AMD Elan SC400 and SC410"
 	depends on MELAN
-	---help---
+	help
 	  This adds the CPUFreq driver for AMD Elan SC400 and SC410
 	  processors.
 
@@ -87,7 +87,7 @@
 config SC520_CPUFREQ
 	tristate "AMD Elan SC520"
 	depends on MELAN
-	---help---
+	help
 	  This adds the CPUFreq driver for AMD Elan SC520 processor.
 
 	  For details, take a look at <file:Documentation/cpu-freq/>.
```
